## firmware/usb-smoke/sdkconfig.defaults
```kconfig
# DEV-001 固定实验基线：ESP-IDF v5.3.2 / esp32s3 / 16MB Flash。
# 仅 USB 供电，不启用 PSRAM、Wi-Fi 初始化、BLE、SD、IMU、音频。

CONFIG_IDF_TARGET="esp32s3"
CONFIG_ESPTOOLPY_FLASHSIZE_16MB=y
CONFIG_PARTITION_TABLE_SINGLE_APP_LARGE=y

# USB Serial/JTAG 作为主控制台；选择该主控制台后不再配置 secondary。
CONFIG_ESP_CONSOLE_USB_SERIAL_JTAG=y

# 不加 Wi-Fi/BT 功能；BT 组件关闭。
CONFIG_BT_ENABLED=n

# 出错时打印并停住，避免无限重启。
CONFIG_ESP_SYSTEM_PANIC_PRINT_HALT=y

CONFIG_LOG_DEFAULT_LEVEL_INFO=y
CONFIG_ESP_MAIN_TASK_STACK_SIZE=4096
```
